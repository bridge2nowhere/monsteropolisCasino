#include <Tinyfont.h>
#include <Arduboy2.h>
#include "arduino.h"

Arduboy2 arduboy;
Tinyfont tinyfont = Tinyfont(arduboy.sBuffer, Arduboy2::width(), Arduboy2::height());

int gold = 100;

const char * const LIZARD_NAMES[] PROGMEM = {"Iv","Jhox","Edres","Urthi","Odhu","Dulrurth","Irthi","Nurhticun","Netirre","Rudegroch","Shosj","Vaess","Thacherk","Korhti","Nirhty","Boshu","Repestri","Asharu","Tork","Shisk","Doskos","Maslo","Ogge","Otes","Daltekhi","Thothrica","Lo","Esh","Nalthis","Etrin","Thurdyss","Thargox","Thoggy","Egisort","Shetistink","Lortignonk"};

const unsigned char SPLASH[] PROGMEM = {0x00, 0xe0, 0xe0, 0xc0, 0x40, 0x60, 0xe0, 0xc0, 0xc0, 0x40, 0x40, 0xc0, 0xc0,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 0x00, 0x00};

enum class GameState : uint8_t
{
  SplashScreen,
  MenuScreen,
  LizardRacing,
  NilbogsRevenge,
  OtherGame,
  Credits
};
GameState gameState = GameState::SplashScreen; 

void setup() {
  arduboy.begin();
  arduboy.setFrameRate(30);
  arduboy.initRandomSeed();
}

void loop() {
  arduboy.clear();
  if (!(arduboy.nextFrame()))
    return;

  //check screen mode and display splashScreen of move on
  if (gameState == GameState::SplashScreen) splashScreen();
  if (gameState == GameState::MenuScreen) menuScreen();
  if (gameState == GameState::Credits) credits();
}

void splashScreen()
{
  //shows splash screen then moves on
  bool moveOn = false;
  arduboy.drawBitmap(0,0,SPLASH,128,47, WHITE);
  arduboy.setCursor(0,50);  
  arduboy.println(F(" Press A to Continue"));
  arduboy.display();
  while (!moveOn) {
   arduboy.pollButtons();
   if(arduboy.justPressed(A_BUTTON)){
      moveOn = true;
      gameState = GameState::MenuScreen;
      arduboy.clear();
   }
  }  
}

byte menuChoice = 0;
bool menuMoveOn = false;

void menuScreen()
{

   
   //arduboy.println("Menu");
   tinyfont.setCursor(0,0);
   tinyfont.print(F("HEY, GOBLIN, YOU WORK AT\nTHE CASINO NOW.\nMAKE THE BOSS HAPPY\nBY MAKING MONEY, OR ELSE!"));
   arduboy.setCursor(0,30);
   arduboy.println("  Lizard Racing");
   arduboy.println("  Nilbogs Revenge");
   arduboy.println("  Other Game");
   arduboy.println("  Credits");
   //arduboy.display();
   if (menuChoice == 0) arduboy.setCursor(0,30);
   if (menuChoice == 1) arduboy.setCursor(0,38);
   if (menuChoice == 2) arduboy.setCursor(0,46);  
   if (menuChoice == 3) arduboy.setCursor(0,52);
   arduboy.print (">");
   arduboy.display();
   arduboy.pollButtons();
   if(arduboy.justPressed(DOWN_BUTTON)) menuChoice ++;
   if(arduboy.justPressed(UP_BUTTON)) menuChoice --;
   if (menuChoice > 3) menuChoice = 0;
   if (menuChoice < 0) menuChoice = 3;
   if(arduboy.justPressed(A_BUTTON)){
    menuMoveOn = true;
    if (menuChoice == 0) gameState = GameState::LizardRacing;
    if (menuChoice == 1) gameState = GameState::NilbogsRevenge;
    if (menuChoice == 2) gameState = GameState::OtherGame;
    if (menuChoice == 3) gameState = GameState::Credits;
   }
}

void axeBeakRacing()
{
  //make racer list
  byte racer[4];
  for(byte  i = 0; i < 4; i++) {
    racer[i] = random(1,35);
  }
}

void credits()
{
  tinyfont.setCursor(0,0);
  tinyfont.print(F("Monsteropolis is a\nfabulous destination for\nall who have riches or wish to become rich. Come for a stage show, play in the casino, visit the markets. Located in Northern Faerun, just a short boat ride from Mirabar. Monsteropolis was founded by great, bugbear warlord Gorehunger, friend of the dwarves, annihilator of the hill giants, his swashbuckling brother Gregek, navigator of the skies, and their boon companion Sloop the Bone Harvester, of the lizard folk, paramount of the bone carvers. This resort was imagined by a Ben, Ryan, Andrew and Dan, a Dungeons and Dragons adventuring group while attempting to save the world from the wrath of the giants."));
}
