#include <Tinyfont.h>
#include <Arduboy2.h>

Arduboy2 arduboy;
Tinyfont tinyfont = Tinyfont(arduboy.sBuffer, Arduboy2::width(), Arduboy2::height());

int gold = 100;

const char liz0[] PROGMEM = "Iv";
const char liz1[] PROGMEM = "Jhox";
const char liz2[] PROGMEM = "Edres";
const char liz3[] PROGMEM = "Urthi";
const char liz4[] PROGMEM = "Odhu";
const char liz5[] PROGMEM = "Dulrurth";
const char liz6[] PROGMEM = "Irthi";
const char liz7[] PROGMEM = "Nurhticun";
const char liz8[] PROGMEM = "Netirre";
const char liz9[] PROGMEM = "Lortgonk";
const char liz10[] PROGMEM = "Rudegroh";
const char liz11[] PROGMEM = "Shosj";
const char liz12[] PROGMEM = "Vaess";
const char liz13[] PROGMEM = "Thacherk";
const char liz14[] PROGMEM = "Korhti";
const char liz15[] PROGMEM = "Nirhty";
const char liz16[] PROGMEM = "Boshu";
const char liz17[] PROGMEM = "Repestri";
const char liz18[] PROGMEM = "Asharu";
const char liz19[] PROGMEM = "Tork";
const char liz20[] PROGMEM = "Shisk";
const char liz21[] PROGMEM = "Doskos";
const char liz22[] PROGMEM = "Maslo";
const char liz23[] PROGMEM = "Ogge";
const char liz24[] PROGMEM = "Otes";
const char liz25[] PROGMEM = "Daltekhi";
const char liz26[] PROGMEM = "Thothric";
const char liz27[] PROGMEM = "Lo";
const char liz28[] PROGMEM = "Esh";
const char liz29[] PROGMEM = "Nalthis";
const char liz30[] PROGMEM = "Etrin";
const char liz31[] PROGMEM = "Thurdyss";
const char liz32[] PROGMEM = "Thargox";
const char liz33[] PROGMEM = "Thoggy";
const char liz34[] PROGMEM = "Egisort";
const char liz35[] PROGMEM = "Stistink";



const char * const LizardNames[] PROGMEM = {liz0, liz1, liz2,liz3,liz4,liz5,liz6,liz7,liz8,liz9,liz10,liz11,liz12,liz13,liz14,liz15,liz16,liz17,liz18,liz19,liz20,liz21,liz22,liz23,liz24,liz25,liz26,liz27,liz28,liz29,liz30,liz31,liz32,liz33,liz34,liz35};
const unsigned char Splash[] PROGMEM = {0x00, 0xe0, 0xe0, 0xc0, 0x40, 0x60, 0xe0, 0xc0, 0xc0, 0x40, 0x40, 0xc0, 0xc0,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 0x00, 0x00};
const unsigned char Over[] PROGMEM = {0x00, 0x00, 0x00, 0x00, 0x00, 0xc, 0xc8, 0x78, 0x30, 0x30, 0x20, 0x20, 0x60,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 0x00,  };

//lizard racing variables
bool setupLizardRace = true;
byte racer[4];
byte racerOdds[4];
byte lizardPosn[4];
byte lizardMoveCounter = 0;
boolean lizardsGo = false;
byte myLizard = 0;
int myLizardBet = 5;
bool lizardWinFlag = true;


//menu variables
byte menuChoice = 0;
bool menuMoveOn = false;

//credit screen varaibles
byte creditScreen = 0;



enum class GameState : uint8_t
{
  SplashScreen,
  MenuScreen,
  LizardBetting,
  LizardRacing,
  NilbogsRevenge,
  OtherGame,
  GameOver,
  Credits
};
GameState gameState = GameState::SplashScreen; 

void setup() {
  arduboy.begin();
  arduboy.setFrameRate(30);
  arduboy.initRandomSeed();
}

void loop() {
  arduboy.clear();
  if (!(arduboy.nextFrame()))
    return;

  //check screen mode and display splashScreen of move on
  if (gameState == GameState::SplashScreen) splashScreen();
  if (gameState == GameState::MenuScreen) menuScreen();
  if (gameState == GameState::Credits) credits();
  if (gameState == GameState::LizardBetting) lizardBet();
  if (gameState == GameState::LizardRacing) lizardRacing();
  if (gameState == GameState::NilbogsRevenge) revenge();
  if (gameState == GameState::GameOver) gameOver();
}

void splashScreen() {
  //shows splash screen then moves on
  bool moveOn = false;
  arduboy.drawBitmap(0,0,Splash,128,47, WHITE);
  arduboy.setCursor(0,50);  
  arduboy.println(F(" Press A to Continue"));
  arduboy.display();
  while (!moveOn) {
   arduboy.pollButtons();
   if(arduboy.justPressed(A_BUTTON)){
      moveOn = true;
      gameState = GameState::MenuScreen;
      arduboy.clear();
   }
  }  
}

void gameOver() {
  arduboy.drawBitmap(0,0,Over,128,64,WHITE);
  arduboy.display();
}

void menuScreen() {
   //arduboy.println("Menu");
   tinyfont.setCursor(0,0);
   tinyfont.print(F("HEY, GOBLIN, YOU WORK AT\nTHE CASINO NOW.\nMAKE THE BOSS HAPPY\nBY MAKING MONEY, OR ELSE!"));
   arduboy.setCursor(0,30);
   arduboy.println(F("  Lizard Racing"));
   arduboy.println(F("  Nilbogs Revenge"));
   arduboy.println(F("  Other Game"));
   arduboy.println(F("  Credits"));
   if (menuChoice == 0) arduboy.setCursor(0,30);
   if (menuChoice == 1) arduboy.setCursor(0,38);
   if (menuChoice == 2) arduboy.setCursor(0,46);  
   if (menuChoice == 3) arduboy.setCursor(0,54);
   arduboy.print (">");
   arduboy.display();
   arduboy.pollButtons();
   if(arduboy.justPressed(DOWN_BUTTON)) menuChoice ++;
   if(arduboy.justPressed(UP_BUTTON)) menuChoice --;
   if (menuChoice > 3) menuChoice = 0;
   if (menuChoice < 0) menuChoice = 3;
   if(arduboy.justPressed(A_BUTTON)){
    menuMoveOn = true;
    if (menuChoice == 0) gameState = GameState::LizardBetting;
    if (menuChoice == 1) gameState = GameState::NilbogsRevenge;
    if (menuChoice == 2) gameState = GameState::OtherGame;
    if (menuChoice == 3) gameState = GameState::Credits;
   }
}

/////////////////////////////////////

byte calledMain = 5;
boolean rolling = false;

void revenge() {
  arduboy.clear();
  if (!rolling) initializeMain();
  else {
    arduboy.println("Main has been called");
    arduboy.display();
  }
  
}

void initializeMain() {
  arduboy.clear();
  arduboy.print("Main = ");
  arduboy.println(calledMain);
  arduboy.display();
  arduboy.pollButtons();
  if(arduboy.justPressed(DOWN_BUTTON)) calledMain --;
  if(arduboy.justPressed(UP_BUTTON)) calledMain ++;
  if (calledMain > 9) calledMain = 5;
  if (calledMain < 5) calledMain = 9;
  if(arduboy.justPressed(A_BUTTON)) {
    rolling = true;
  }
}

/////////////////////////////////////



void lizardRacing() {
  arduboy.println(getLizardName(racer[0]));
  arduboy.println(getLizardName(racer[1]));
  arduboy.println(getLizardName(racer[2]));
  arduboy.println(getLizardName(racer[3]));
  arduboy.pollButtons();
  if (arduboy.justPressed(B_BUTTON)) {
    setupLizardRace = true;
    gameState = GameState:: MenuScreen;
  }
  if (!lizardsGo) {
    arduboy.setCursor(0,46);
    arduboy.println(F("Press A to Go"));
  }
  if (!lizardsGo && arduboy.justPressed(A_BUTTON)) lizardsGo = true;
  if (lizardsGo) lizardMove();
  arduboy.display();
}

void lizardSetup() {
  //reset & fill racer array
  for (byte r = 0; r < 4; r++) {
    racer[r] = 200;
    racerOdds[r] = 0;
    lizardPosn[r] = 60;
  }
  do {
    for(byte  i = 0; i < 4; i++) {
      racer[i] = random(0,36);
      racerOdds[i] = random(2,13);
    }
  } while (racer[0] == racer[1] || racer[0] == racer[2] || racer[0] == racer[3] || racer[1] == racer[2] || racer[1] == racer[3] || racer[2] == racer[3]);
  lizardMoveCounter = 0;
  lizardsGo = false;
  myLizard = 0;
  myLizardBet = 5;
  setupLizardRace = false;
  lizardWinFlag = true;
}

void lizardBet() {
  if (setupLizardRace) lizardSetup();
  arduboy.clear();
  for(byte i=0; i < 4; i++){
    arduboy.print(' ');
    arduboy.print(getLizardName(racer[i]));
    arduboy.setCursor(60,arduboy.getCursorY());
    arduboy.print(F(" Odds 1:"));
    arduboy.println(racerOdds[i]);
  }
  arduboy.println();
  arduboy.println();
  arduboy.print(F("L/R Bet="));
  arduboy.print(myLizardBet);
  arduboy.print(F(" of "));
  arduboy.print(gold);
  if (myLizard == 0) arduboy.setCursor(0,0);
  if (myLizard == 1) arduboy.setCursor(0,8);
  if (myLizard == 2) arduboy.setCursor(0,16);  
  if (myLizard == 3) arduboy.setCursor(0,24);
  arduboy.print ('>');
  arduboy.display();
  arduboy.pollButtons();
  if (arduboy.justPressed(B_BUTTON)){
    gameState = GameState:: MenuScreen;
    setupLizardRace = true;
  }
  if (arduboy.justPressed(A_BUTTON)) {
    gameState = GameState::LizardRacing;
  }
  if (arduboy.justPressed(UP_BUTTON)) {
    myLizard --;
  }
  if (arduboy.justPressed(DOWN_BUTTON)) {
    myLizard ++;
  }
  if (arduboy.justPressed(LEFT_BUTTON)) {
    myLizardBet -= 5;
  }
  if (arduboy.justPressed(RIGHT_BUTTON)) {
    myLizardBet += 5 ;
  }
  if (myLizardBet > gold) myLizardBet = gold;
  else if (myLizardBet < 0) myLizardBet = 0;
  if (myLizard > 3) myLizard = 0;
  else if (myLizard < 0) myLizard = 3;
}

void lizardMove() {
  if (lizardMoveCounter == 0){
    byte posnY = 0;
    for(byte i = 0; i < 4; i++)
    {
      arduboy.setCursor(lizardPosn[i],posnY);
      arduboy.print('~');
      posnY += 8;
    }
    lizardMoveCounter ++;
  }
  else if (lizardMoveCounter < 24) {
    byte posnY = 0;
    for( byte i = 0; i < 4; i++)
    {
      if(random(1,13) < (13 - racerOdds[i])) {
          lizardPosn[i] += random(2,5);
      }
      else {
         lizardPosn[i] += 1;
      }
        
      arduboy.setCursor(lizardPosn[i],posnY);
      arduboy.print('~');
      posnY += 8;
    }
    lizardMoveCounter ++;
  }
  else  {
    byte posnY = 0;
    for( byte i = 0; i < 4; i++) {
      arduboy.setCursor(lizardPosn[i],posnY);
      arduboy.print('~');
      posnY += 8;
      lizardWinner();
    }
  }
}

void lizardWinner() {
  byte max_v = 0;
  byte max_i = 0;
 
  for ( int i = 0; i < 4; i++ )
  {
    if ( lizardPosn[i] > max_v )
    {
      max_v = lizardPosn[i];
      max_i = i;
    }
  }
  arduboy.setCursor(0,46);
  arduboy.print(getLizardName(racer[max_i]));
  arduboy.println(F(" wins"));

  
  if (max_i == myLizard){
    arduboy.print(F("You Win "));
    arduboy.println(myLizardBet + (myLizardBet * racerOdds[max_i]));
    if (lizardWinFlag) win(myLizardBet + (myLizardBet * racerOdds[max_i]));
    lizardWinFlag = false;
  }
  else {
    arduboy.print(F("You loose "));
    arduboy.print(myLizardBet);
    if (lizardWinFlag) loose(myLizardBet);
    lizardWinFlag = false;
  }

}

void loose(int amount) {
  gold -= amount;
  if (gold <= 0) {
    gold = 0;
    gameState = GameState::GameOver;   
  }
  
}

void win(int amount) {
  gold += amount;
}

const __FlashStringHelper * getLizardName(uint8_t index) {
  return reinterpret_cast<const __FlashStringHelper *>(pgm_read_ptr(&LizardNames[index]));
}

void credits() {
  tinyfont.setCursor(0,0);
  if (creditScreen == 0) tinyfont.print(F("MONSTEROPOLIS IS A \nFABULOUS DESTINATION FOR\nALL WHO HAVE RICHES OR\nWISH TO BECOME RICH. COME\nFOR A STAGE SHOW, PLAY IN\nTHE CASINO, VISIT THE\nMARKETS. CONVEINENTLY\nLOCATED IN NORTHERN\nFAERUN, JUST A SHORT BOAT\nRIDE FROM MIRABAR.")); 
  if (creditScreen == 1) tinyfont.print(F("MONSTEROPOLIS WAS\nFOUNDED BY GREAT,\nBUGBEAR WARLORD\nGOREHUNGER, FRIEND OF\nTHE DWARVES, ANNIHILATOR\nOF THE HILL GIANTS, HIS\nSWASHBUCKLING BROTHER\nGREGEK, NAVIGATOR OF THE\nSKIES, AND THEIR BOON\nCOMPANION SLOOP THE BONE\nHARVESTER, OF THE LIZARD\nFOLK, PARAMOUNT OF THE\nBONE CARVERS.")); 
  if (creditScreen == 2) tinyfont.print(F("THIS RESORT WAS IMAGINED\nBY A BEN, RYAN, ANDREW\nAND DAN, A DUNGEONS AND\nDRAGONS ADVENTURING\nGROUP WHILE ATTEMPTING TO\nSAVE THE WORLD FROM THE\nWRATH OF THE GIANTS."));
  arduboy.display();
  arduboy.pollButtons();
  if(arduboy.justPressed(A_BUTTON)){
    creditScreen ++;
    if (creditScreen > 2) gameState = GameState::MenuScreen;
  }
}
